## components/bk_phy/Kconfig
```kconfig
#TODO optimize it
menu "Bk_Phy"

	config PHY_LOG_ENABLE
		bool "Enable voltage detect"
		default n

	config RF_FIRMWARE_DYNAMIC_PARTITION
		bool "Enable rf firmware partition dynamic"
		default n

endmenu
```

## components/bk_vfs/Kconfig
```kconfig
menu "Bk_vfs"
	config VFS
		bool "Enable Vfs"
		default n

	config VFS_MAX_FD_NUM
			int "bk vfs max file fd num"
			default 20
			help
				bk vfs max file fd num

	config REMOTE_VFS_SERVER
		depends on VFS
		bool "Enable remote vfs server for multi CPUs using"
		default n

	config REMOTE_VFS_CLIENT
		depends on !VFS
		bool "Enable remote vfs client for multi CPUs using"
		default n

endmenu
```

## components/littlefs/Kconfig
```kconfig
menu "Littlefs"
	config LITTLEFS
		bool "Enable Littlefs"
		default n

	choice LITTLEFS_PARTITION
		depends on LITTLEFS
		prompt "choose partition"
		default LITTLEFS_NO_CONFIG_PARTITION

		config LITTLEFS_USE_LITTLEFS_PARTITION
			depends on LITTLEFS
			bool "use littlefs partition as littlefs partition"
		config LITTLEFS_USE_USR_CONFIG_PARTITION
			depends on LITTLEFS
			bool "use usr_config partition as littlefs partition"
		config LITTLEFS_NO_CONFIG_PARTITION
			depends on LITTLEFS
			bool "no config littlefs partition"
	endchoice

	config LITTLEFS_QSPI_FLASH_ID
		int "The QSPI-Flash uses which QSPI Port, QSPI_ID_0 or others"
		depends on LITTLEFS && QSPI
		default 0
endmenu
```

## middleware/driver/lcd/Kconfig
```kconfig
menu "LCD"
	config LCD
		bool "Enable LCD"
		default n

	config LCD_QSPI
		depends on QSPI
		bool "Enable LCD QSPI"
		default n

	config LCD_QSPI_DEVICE_NUM
		depends on LCD_QSPI
		int "Set lcd qspi device number"
		default 1

	config LCD_QSPI_COLOR_DEPTH_BYTE
		depends on LCD_QSPI
		int "Set lcd qspi color depth"
		default 2
		help
			2 - RGB565
			3 - RGB888

	config LCD_QSPI_TE
		bool "Enable LCD QSPI TE"
		default n

	config LCD_POWER_GPIO_CTRL
		bool "Enable lcd power gpio ctrl"
		default n

	config LCD_BACKLIGHT_GPIO_CTRL
		bool "Enable lcd backlight gpio ctrl"
		default n

	config LCD_SPI
		bool "Enable LCD SPI"
		default n

	config LCD_SPI_DEVICE_NUM
		depends on LCD_SPI
		int "Set lcd spi device number"
		default 1

	config LCD_SPI_TE
		bool "Enable LCD SPI TE"
		default n
endmenu
```

## middleware/driver/qspi/Kconfig
```kconfig
menu "QSPI"
	config QSPI
		bool "Enable QSPI"
		default n

	config QSPI_STATIS
		bool "Enable QSPI Statis"
		default y

	config QSPI_FLASH
		bool "Enable QSPI Flash"
		depends on QSPI
		default n
	config QSPI_FLASH_GD
		bool "Enable GD Flash"
		default n

	config QSPI_LINE_MODE
		int "qspi line mode choose"
		range 1 8
		default 4
		help
		The value should be changed if need to change qspi line mode
endmenu
```
